//------------Blynk Library included for saving the data in database
#include <BlynkSimpleEsp8266.h>
//-------------------------------------------------------------------------------
#include <Wire.h>
#include <Adafruit_GFX.h>
#include <Adafruit_SSD1306.h>
#include <SPI.h>
//---------Libraries for Asynchronous Web Server----------
#include <Arduino.h>
#include <ESP8266WiFi.h>
#include <Hash.h>
#include <ESPAsyncTCP.h>
#include <ESPAsyncWebServer.h>
#include <Adafruit_Sensor.h>
//--------------------Libraries for DS18B20-----------------
#include <DallasTemperature.h>
#include <OneWire.h>
//-----------------------Network Credentials--------------------------------
const char *ssid = "wifiname";
const char *password = "wifipassword";
//------------Static Ip Configaration--------
char auth[] = "fJe1ydYAFv2NVUsa8HWouIrna6Z4kAE7";
BlynkTimer timer;
//IPAddress staticIP(192, 168 , 0 ,221 );
//IPAddress gateway(192, 168 , 0 ,1 );
//IPAddress subnet(255, 255 , 255 , 0 );
//IPAddress dns( 8 , 8 , 8 ,8 );
int i = 0;
//------------------------------------ Create AsyncWebServer object on port 80---------------------------------------------------------
AsyncWebServer server(80);
#define ONE_WIRE_BUS 2   //D2 pin of nodemcu
#define SCREEN_WIDTH 128 // OLED display width, in pixels
#define SCREEN_HEIGHT 64 // OLED display height, in pixels
#define OLED_RESET 14
OneWire oneWire(ONE_WIRE_BUS);
float t = 0.0; // temperature variable for soil temperature
//Declaration for an SSD1306 display connected to I2C (SDA, SCL pins)
Adafruit_SSD1306 display(SCREEN_WIDTH, SCREEN_HEIGHT, &Wire, OLED_RESET);
int Sensor_pin = A0;
int moisture = 0;
String moisturevalue; // Variable to be passed in Asynchronous web Server.
float moisture_percentage = 0.00;
//--------------------------------------------------------Root HTML CODE--------------------------------------------------------------------------------------------------------
const char index_html[] PROGMEM = R"rawliteral(
<!DOCTYPE HTML><html>
<head>
  <meta name="viewport" content="width=device-width, initial-scale=1">
    <script src="https://code.highcharts.com/highcharts.js"></script>
  <style>
    body {
       margin: 0 auto;
      min-height:100%;}
    h2 {
      font-family: Arial;
      font-size: 4.0rem;
      text-align: center;
  }
 .grid-container {
  display: grid;
  grid-template-columns: auto auto auto;
  padding: 10px;
}
  h1{
  text-align:center;
}
.container{
    height: 450px;
    width: 650px;
}
#moisturesensor{
    text-align: center;
    font-size: 20px;
    font-size: 40px;
    }
#plantstatus{
  height: 300px;
    margin-top: 5%;
 }
  .grid-item {
  padding: 30px;
  font-size: 30px;
  text-align: center;
}
</style>
</head>
<body>
  <h2 style="color:#213346;">SOIL MOISTURE MONITORING</h2>
   <div id="moisturesensor">
   <span class="sensor_label">Moisture:</span> 
   <span id="SensorValue">%Moisture%</span>
   <span> %</span> 
   </div>
  <!-- -----------------------------------Displaying the Sensor Value ------------------------------------->
 <div class="grid-container">
 <img class="grid-item" id="plantstatus" src="https://cdn.pixabay.com/photo/2013/07/12/19/24/seedling-154735__340.png">
  <div id="chart-SoilSensor" class="container"></div>
  </div>
   <br>
 </body>
 <script>
var chartT = new Highcharts.Chart({
  chart:{ renderTo : 'chart-SoilSensor' },
  title: { text: '' },
  series: [{
    showInLegend: false,
    data: []
  }],
  plotOptions: {
    line: { animation: false,
      dataLabels: { enabled: true }
    },
    series: { color: '#059e8a' }
  },
  xAxis: { type: 'datetime',
    dateTimeLabelFormats: { second: '%H:%M:%S' }
  },
  yAxis: {
    title: { text: 'Moisture(%)' }
    
  },
  credits: { enabled: false }
});
setInterval(function ( ) {
  var xhttp = new XMLHttpRequest();
  xhttp.onreadystatechange = function() {
    if (this.readyState == 4 && this.status == 200) {
     var x = (new Date()).getTime(),  //X axis for time representation
         y = parseFloat(this.responseText);  //Y axix for Moisture Percentage Representation
         document.getElementById("SensorValue").innerHTML = this.responseText;
               //console.log(this.responseText);
  //-------------------Displaying Image and Gif according to the moisture status-------------------------------------
   if(y<30){
    document.getElementById("plantstatus").src='https://st2.depositphotos.com/1744275/11481/v/950/depositphotos_114816898-stock-illustration-dead-flower-vector-doodle-illustration.jpg';
    
   }
     else if(y>30 && y<50){
      //document.getElementById("plantstatus").src='https://im6.ezgif.com/tmp/ezgif-6-5198d2b26f85.gif';
      document.getElementById("plantstatus").src='https://www.latestgadget.co/wp-content/uploads/2018/11/pqvxlfws_watering-can.gif';
     }
   
    else if(y>50){
      document.getElementById("plantstatus").src='https://cdn.pixabay.com/photo/2013/07/12/19/24/seedling-154735__340.png';
     }
               
      if(chartT.series[0].data.length > 60) {
        chartT.series[0].addPoint([x, y], true, true, true);
      } else {
        chartT.series[0].addPoint([x, y], true, false, true);
      }
    }
  };
   xhttp.open("GET", "/Moisturevalue", true);
  xhttp.send();
}, 3000 ) ;
</script>
 </html>)rawliteral";

//Function to display logo
void Displaylogo()
{
    static const uint8_t image_data_array[] = {
        0xff, 0xff, 0xff, 0xff, 0xff, 0xff, 0xff, 0xff, 0xff, 0xff, 0xff, 0xff, 0xff, 0xff, 0xff, 0xff,
        0xff, 0xff, 0xff, 0xff, 0xff, 0xff, 0xff, 0xff, 0xff, 0xff, 0xff, 0xff, 0xff, 0xff, 0xff, 0xff,
        0xff, 0xff, 0xff, 0xff, 0xff, 0xff, 0xff, 0xfe, 0x7f, 0xff, 0xff, 0xff, 0xff, 0xff, 0xff, 0xff,
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        0xff, 0xff, 0xff, 0xff, 0xff, 0xff, 0xff, 0xff, 0xff, 0xff, 0xff, 0xff, 0xff, 0xff, 0xff, 0xff

    };
    //Clear the Buffer
    display.clearDisplay();
    //Draw bitmap on the screen
    display.drawBitmap(0, 0, image_data_array, 127, 64, 1);
    display.display();
    delay(3000);
}

// Soil Moisture less than 30 %
void Displaypot1()
{
    static const uint8_t image_data_array[] = {
        // 'pot3, 60x60px
        0xff, 0xff, 0xff, 0xff, 0xff, 0xff, 0xff, 0xff, 0xff, 0xff, 0xff, 0xff, 0xff, 0xff, 0xff, 0xff,
        0xff, 0xff, 0xff, 0xff, 0xff, 0xff, 0xff, 0xff, 0xff, 0xff, 0xff, 0xff, 0xff, 0xff, 0xff, 0xff,
        0xff, 0xff, 0xff, 0xff, 0xff, 0xff, 0xff, 0xff, 0xff, 0xff, 0xff, 0xff, 0xff, 0xff, 0xff, 0xff,
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        0xff, 0xff, 0xff, 0xff, 0xff, 0xff, 0xff, 0xff, 0xff, 0xff, 0xff, 0xff, 0xff, 0xff, 0xff, 0xff};
    //Clear the Buffer
    display.clearDisplay();
    //Draw bitmap on the screen
    display.drawBitmap(0, 0, image_data_array, 128, 64, 1);
    display.display();
    delay(1000);
}

// Soil moisture between 30 - 45 %
void Displaypot2()
{
    static const uint8_t image_data_array[] = {
        // 'pot3, 60x60px
        0xff, 0xff, 0xff, 0xff, 0xff, 0xff, 0xff, 0xff, 0xf0, 0x70, 0x00, 0x07, 0xcf, 0xff, 0xff, 0xff,
        0xff, 0xff, 0xff, 0xff, 0xff, 0xff, 0xff, 0xff, 0xf0, 0x30, 0x00, 0x07, 0xcf, 0xff, 0xff, 0xff,
        0xff, 0xff, 0xff, 0xff, 0xff, 0xff, 0xff, 0xff, 0xf8, 0x01, 0xff, 0x8f, 0xcf, 0xff, 0xff, 0xff,
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        0xff, 0xff, 0xff, 0xff, 0xff, 0x80, 0x00, 0x3f, 0xff, 0xff, 0xff, 0xff, 0xff, 0xff, 0xff, 0xff};
    //Clear the Buffer
    display.clearDisplay();
    //Draw bitmap on the screen
    display.drawBitmap(0, 0, image_data_array, 128, 64, 1);
    display.display();
    delay(1000);
}

// Soil Moisture above 50 %
void Displaypot3()
{
    static const uint8_t image_data_array[] = {
        // 'pot3, 60x60px
        0x00, 0x00, 0x00, 0x00, 0x00, 0x00, 0x00, 0x00, 0x00, 0x00, 0x00, 0x00, 0x00, 0x00, 0x00, 0x00,
        0x00, 0x00, 0x00, 0x00, 0x00, 0x00, 0x00, 0x00, 0x00, 0x00, 0x00, 0x00, 0x00, 0x00, 0x00, 0x00,
        0x00, 0x00, 0x00, 0x00, 0x00, 0x00, 0x00, 0x00, 0x00, 0x00, 0x00, 0x00, 0x00, 0x00, 0x00, 0x00,
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        0x00, 0x00, 0x00, 0x00, 0x00, 0x00, 0x00, 0x00, 0x00, 0x00, 0x00, 0x00, 0x00, 0x00, 0x00, 0x00};
    //Clear the Buffer
    display.clearDisplay();
    //Draw bitmap on the screen
    display.drawBitmap(0, 0, image_data_array, 128, 64, 1);
    display.display();
    delay(1000);
}

//Fuction to display moisture on serial moniter
String ReadMoisture(int moisture)
{

    Serial.print(" Analog Value = ");
    Serial.print(analogRead(Sensor_pin));
    moisture_percentage = (100.00 - (moisture / 1023.00) * 100.00);
    Blynk.virtualWrite(V21, moisture_percentage);
    Serial.print(" Moisture Percenage =");
    Serial.print(moisture_percentage);
    Serial.println(" %");
    return String(moisture_percentage);
    delay(500);
}

//Fuction to display moisture on led.
void leddisplay(int moisture)
{
    display.setCursor(0, 0);
    display.clearDisplay();
    // Calculatig Percentage
    float moisture_percentage;
    moisture_percentage = (100.00 - moisture / 1023.00 * 100.00);
    //Displaying it on led
    display.setCursor(0, 0);
    display.setTextSize(1);
    display.setTextColor(WHITE);
    display.println("    Moisture");
    display.println();
    display.println();
    display.display();
    display.setTextSize(3);
    display.print(" ");
    display.print(moisture_percentage);
    display.println("%");
    display.display();
    delay(5000);
}
/* function made to avoid showing percentage sign at the start.To use it should be passed in http root request.
String processor(const String& var){
  //Serial.println(var);
  if(var == "Moisture"){
    moisturevalue = ReadMoisture(moisture);
    return String(moisturevalue);
  }
 
  
  return String();
}
*/
DallasTemperature sensors(&oneWire); //Passing Onewire reference in Dallastemperature
                                     //-------------------peridocally data is sent in database--------------
void myTimerEvent()
{ // You can send any value at any time.
    // Please don't send more that 10 values per second.
    String moisttempstring;
    moisttempstring = String(moisture_percentage) + "," + String(t);
    // Blynk.virtualWrite(V0,"192.168.0.221");
    Blynk.virtualWrite(V22, moisttempstring);
    //Blynk.virtualWrite(V21,moisture_percentage );
    Serial.println("v22 Saved in Database");
}

//----------------------------Setup starts here---------------
void setup(void)
{

    Serial.begin(115200);
    //Blynk.begin(auth, ssid, password,IPAddress(192,168,0,10), 8080);
    if (!display.begin(SSD1306_SWITCHCAPVCC, 0x3C))
    { // Address 0x3D for 128x64
        Serial.println(F("SSD1306 allocation failed"));
        for (;;)
            ;
    }
    //--------------------------------Connecting to Wifi--------------------------------------
    //WiFi.config(staticIP,gateway,subnet,dns);
    WiFi.begin(ssid, password);
    Serial.println("Connecting to WiFi");
    while (WiFi.status() != WL_CONNECTED)
    {
        delay(1000);
        Serial.println(".");
    }
    //Print ESP8266 Local IP Address
    Serial.println(WiFi.localIP());
    //-------------------------Http Requests--------------------------------------------------------
    // Route for root / web page
    server.on("/", HTTP_GET, [](AsyncWebServerRequest *request)
              { request->send_P(200, "text/html", index_html); });
    //--------------Route for sending moisture value------------------
    server.on("/Moisturevalue", HTTP_GET, [](AsyncWebServerRequest *request)
              { request->send_P(200, "text/plain", moisturevalue.c_str()); });

    //--------------------------------Route for sending Soil Temperature value-----------
    server.on("/temperature", HTTP_GET, [](AsyncWebServerRequest *request)
              { request->send_P(200, "text/plain", String(t).c_str()); });
    delay(2000);
    //Clear The Buffer
    display.clearDisplay();
    //Set Curser at 0,0 coordinates
    display.setCursor(0, 0);
    //------------------------Start the Server-----------------------------------------------------------------------
    //Start server
    server.begin();
    sensors.begin();
    //Display The Logo of BVCOE
    //Displaylogo();
    //Display Pot
    //Displaypot();
    // Setup a function to be called every second
    timer.setInterval(300000L, myTimerEvent);
}
void loop()
{
    Blynk.run();
    timer.run();    // Initiates BlynkTimer
    if (i % 3 == 0) //Displaying the logo for 3 seconds
    {
        Displaylogo();
        delay(2000);
        i = 1;
    }
    // Displaying pot image on OLED
    moisture = analogRead(Sensor_pin);
    moisturevalue = ReadMoisture(moisture);
    if (moisturevalue.toInt() < 30)
    {
        Displaypot1();
    }
    else if (moisturevalue.toInt() >= 30 && moisturevalue.toInt() <= 50)
    {
        Displaypot2();
    }
    else
    {
        Displaypot3();
    }
    //Display Analog and percentage moisture on Led
    leddisplay(moisture);

    sensors.requestTemperatures();
    t = sensors.getTempCByIndex(0);
    //Serial.print("Soil Temperature :");
    //Serial.println(t);
}